## CMakeLists.txt
```
cmake_minimum_required(VERSION 3.20.0)
find_package(Zephyr REQUIRED HINTS $ENV{ZEPHYR_BASE})
project(p1_ble)
target_sources(app PRIVATE src/main.c)
```

## prj.conf
```kconfig
# A bonding peripheral whose bonds and identity persist in settings (NVS), as a deployed
# BLE product's do. Plain build: no bootloader.
CONFIG_BT=y
CONFIG_BT_PERIPHERAL=y
CONFIG_BT_SMP=y
CONFIG_BT_SETTINGS=y
CONFIG_SETTINGS=y
CONFIG_FLASH=y
CONFIG_FLASH_MAP=y
CONFIG_NVS=y
CONFIG_BT_DEVICE_NAME="zmig-ble"
```

## src/main.c
```c
#include <zephyr/bluetooth/bluetooth.h>
#include <zephyr/settings/settings.h>

int main(void)
{
	if (bt_enable(NULL) == 0) {
		settings_load();
	}
	return 0;
}
```
