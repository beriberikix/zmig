## CMakeLists.txt
```
cmake_minimum_required(VERSION 3.20.0)
find_package(Zephyr REQUIRED HINTS $ENV{ZEPHYR_BASE})
project(zmig_p1_mode)

target_sources(app PRIVATE src/main.c)
```

## prj.conf
```kconfig
CONFIG_PRINTK=y
# A DFU path, as a field-updatable app has: the image manager writes uploads to the
# secondary slot (how it does so depends on the MCUboot mode the app is built for).
CONFIG_FLASH=y
CONFIG_FLASH_MAP=y
CONFIG_STREAM_FLASH=y
CONFIG_IMG_MANAGER=y
```

## src/main.c
```c
#include <zephyr/kernel.h>

int main(void)
{
	printk("zmig cross fixture on %s\n", CONFIG_BOARD_TARGET);
	return 0;
}
```
